## config/boards/shields/avey_p/Kconfig.defconfig
```kconfig
# Copyright (c) 2020 The ZMK Contributors
# SPDX-License-Identifier: MIT

if avey_p

config ZMK_KEYBOARD_NAME
    default "avey_p"
endif
```

## config/boards/shields/avey_p/Kconfig.shield
```kconfig
# Copyright (c) 2020 The ZMK Contributors
# SPDX-License-Identifier: MIT

config avey_p
    def_bool $(shields_list_contains,avey_p)
```
