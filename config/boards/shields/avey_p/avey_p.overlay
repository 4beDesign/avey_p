/*
 * Copyright (c) 2020 Pete Johanson
 *
 * SPDX-License-Identifier: MIT
 */
#include "avey_p.dtsi"
    kscan0 {
        col-gpios
            = <&pro_micro 7 GPIO_ACTIVE_HIGH>
            , <&pro_micro 8 GPIO_ACTIVE_HIGH>
            , <&pro_micro 9 GPIO_ACTIVE_HIGH>
            , <&pro_micro 10 GPIO_ACTIVE_HIGH>
            , <&pro_micro 11 GPIO_ACTIVE_HIGH>
            , <&pro_micro 12 GPIO_ACTIVE_HIGH>
            , <&pro_micro 13 GPIO_ACTIVE_HIGH>
            , <&pro_micro 14 GPIO_ACTIVE_HIGH>
            , <&pro_micro 15 GPIO_ACTIVE_HIGH>
            , <&pro_micro 20 GPIO_ACTIVE_HIGH>
            , <&pro_micro 22 GPIO_ACTIVE_HIGH>
            , <&pro_micro 23 GPIO_ACTIVE_HIGH>
            ;
    };
